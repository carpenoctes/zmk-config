/*
 * Copyright (c) 2023 The ZMK Contributors
 *
 * SPDX-License-Identifier: MIT
 */


/* Uncomment this block if using RGB
&led_strip {
    chain-length = <6>;
    // chain-length = <31>; // Uncomment if using both per-key and underglow LEDs
    // chain-length = <25>; // Uncomment if using only per-key LEDs.
};
 */
#include "base.keymap"