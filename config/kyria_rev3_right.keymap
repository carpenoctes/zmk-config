/*
 * Copyright (c) 2023 The ZMK Contributors
 *
 * SPDX-License-Identifier: MIT
 */


/* Uncomment this block if using RGB
&led_strip {
    chain-length = <6>;
    // chain-length = <31>; // Uncomment if using both per-key and underglow LEDs
    // chain-length = <25>; // Uncomment if using only per-key LEDs.
};
 */
&kscan0 {
    row-gpios
    = <&pro_micro 19 (GPIO_ACTIVE_HIGH | GPIO_PULL_DOWN)>
    , <&pro_micro 18 (GPIO_ACTIVE_HIGH | GPIO_PULL_DOWN)>
    , <&pro_micro 15 (GPIO_ACTIVE_HIGH | GPIO_PULL_DOWN)>
    , <&pro_micro 14 (GPIO_ACTIVE_HIGH | GPIO_PULL_DOWN)>
    ;
    col-gpios
    = <&pro_micro 16 GPIO_ACTIVE_HIGH>
    , <&pro_micro 4  GPIO_ACTIVE_HIGH>
    , <&pro_micro 5  GPIO_ACTIVE_HIGH>
    , <&gpio1 7 GPIO_ACTIVE_HIGH>
    , <&pro_micro 7  GPIO_ACTIVE_HIGH>
    , <&pro_micro 8  GPIO_ACTIVE_HIGH>
    , <&pro_micro 10 GPIO_ACTIVE_HIGH>
    ;
};
nice_view_spi: &spi0 {
    compatible = "nordic,nrf-spim";
    pinctrl-0 = <&spi0_default>;
    pinctrl-1 = <&spi0_sleep>;
    pinctrl-names = "default", "sleep";
    cs-gpios = <&gpio1 1 GPIO_ACTIVE_HIGH>;
};

#include "base.keymap"